## drivers/input/misc/compass/Kconfig
```kconfig
#
# Kconfig for stand-alone compass input device drivers
#

config INV_YAS53X
    tristate "Invensense Yamaha YAS530/YAS532 compass input device driver"
    depends on I2C && SYSFS && INPUT
    default n
    help
      This driver supports the Yamaha YAS530/YAS532 compass device .
      This driver can be built as a module. The module will be called
      inv-yas53x.

config INV_AK89XX
    tristate "Invensense AKM AK8975/AK8972/AK8963 compass input device drivers"
    depends on I2C && SYSFS && INPUT
    default n
    help
      This driver supports the AKM AK8975/AK8972/AK8963 compass devices.
      This driver can be built as a module. The module will be called
      inv-ak89xx.
```
